## layers/meta-prime-addons/conf/layer.conf
```bitbake
# We have a conf and classes directory, append to BBPATH
BBPATH := "${LAYERDIR}:${BBPATH}"

# We have no recipes directory to add to BBFILES
BBFILES += "${LAYERDIR}/recipes-*/*/*.bb ${LAYERDIR}/recipes-*/*/*.bbappend"
BBFILE_COLLECTIONS += "prime-addons"
BBFILE_PATTERN_prime-addons := "^${LAYERDIR}/"

# Define the priority for recipes (.bb files) from this layer,
# choosing carefully how this layer interacts with all of the
# other layers.
BBFILE_PRIORITY_prime-addons = "10"

# We have a pre-populated downloads directory, add to PREMIRRORS
PREMIRRORS_prepend := "\
     file://.*/.* file://${LAYERDIR}/downloads/ \n \
     git://.*/.* git://${LAYERDIR}/downloads/MIRRORNAME;protocol=file \n \
     git://.*/.* file://${LAYERDIR}/downloads/ \n \
     svn://.*/.* file://${LAYERDIR}/downloads/ \n \
     ftp://.*/.* file://${LAYERDIR}/downloads/ \n \
     http://.*/.* file://${LAYERDIR}/downloads/ \n \
     https://.*/.* file://${LAYERDIR}/downloads/ \n"
```
